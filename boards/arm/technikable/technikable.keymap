#include <behaviors.dtsi>
#include <dt-bindings/zmk/keys.h>
#include <dt-bindings/zmk/bt.h>
#include <dt-bindings/zmk/outputs.h>

#include "helper/functions.h"
#include "helper/keypos_mit.h"

// Layers
#define BASE 0
#define SM1  1
#define SM2  2
#define CD1  3
#define CD2  4
#define CD3  5
#define ADM  6

// Modifier Combos
#define LSG(kc) LS(LG(kc))
#define LSA(kc) LS(LA(kc))
#define LSC(kc) LS(LC(kc))
#define LAG(kc) LA(LG(kc))
#define LCG(kc) LC(LG(kc))
#define LCA(kc) LC(LA(kc))

&lt {
    tapping-term-ms = <200>;
    quick-tap-ms = <150>;
};

&mt {
    tapping-term-ms = <125>;
};

&sk {
    release-after-ms = <2000>;
    quick-release;
    ignore-modifiers;
};

&sl {
    release-after-ms = <1000>;
};

&caps_word {
    continue-list = <LSHFT RSHFT DELETE BSPC UNDERSCORE MINUS>;
};

/ {
    chosen {
       zmk,matrix_transform = &mit_transform;
    };

    macros {
        ZMK_BEHAVIOR(dif_co, macro,
            bindings = <&kp LSG(D) &kp C>;
        )
        ZMK_BEHAVIOR(dif_br, macro,
            bindings = <&kp LSG(D) &kp B>;
        )
    };

    behaviors {
        #define AS(kc)    &as LS(kc) kc         // Auto-Shift Key-press for Alphas
        #define MO(layer) &mo layer             // Momentary Layer
        #define OS(layer) &mo_sl layer layer    // One-Shot Layer

        // Hold Taps
        ZMK_BEHAVIOR(as, hold_tap,
            flavor = "tap-preferred";
            tapping-term-ms = <150>;
            quick-tap-ms = <50>;
            global-quick-tap;
            bindings = <&kp>, <&kp>;
        ) 
        ZMK_BEHAVIOR(mo_sl, hold_tap,
            flavor = "hold-preferred";
            tapping-term-ms = <100>;
            bindings = <&mo>, <&sl>;
        )
        ZMK_BEHAVIOR(hm, hold_tap,
            flavor = "balanced";
            tapping-term-ms = <180>;
            quick-tap-ms = <0>;
            bindings = <&kp>, <&kp>;
        )
        ZMK_BEHAVIOR(cd, hold_tap,
            flavor = "tap-preferred";
            tapping-term-ms = <180>;
            quick-tap-ms = <50>;
            global-quick-tap;
            bindings = <&kp>, <&kp>;
        )
        ZMK_BEHAVIOR(nav, hold_tap,
            flavor = "tap-preferred";
            tapping-term-ms = <300>;
            quick-tap-ms = <50>;
            global-quick-tap;
            bindings = <&kp>, <&kp>;
        )
        
        // Mod Morphs
        ZMK_BEHAVIOR(bspc, mod_morph,
            bindings = <&nav LA(BSPC) BSPC>, <&nav LA(DEL) DEL>;
            mods = <(MOD_LCTL|MOD_RCTL)>;
        )

        // Tap Dances
        ZMK_BEHAVIOR(sft_cw, tap_dance,
            tapping-term-ms = <400>; bindings = <&kp LSHIFT>, <&caps_word>; // 1:(shift), 2:(caps word)
        )
    };

    combos {
        compatible = "zmk,combos";
    
        #define FAST_COMBO_MS 30

        // horizontal
        // ZMK_COMBO_ADV(escape,        &kp ESC,     LT2 LT3,   ALL,   FAST_COMBO_MS)
        // ZMK_COMBO_ADV(tab,           &kp TAB,     LM2 LM3,   ALL,   FAST_COMBO_MS)
        // ZMK_COMBO_ADV(enter,         &kp ENTER,   RM2 RM3,   ALL,   FAST_COMBO_MS)
        // ZMK_COMBO_ADV(backspace,     &bspc,       RT2 RT3,   ALL,   FAST_COMBO_MS)
        ZMK_COMBO_ADV(equal_plus,    AS(EQUAL),     RT3 RT4,   ALL,   FAST_COMBO_MS)
    };

    keymap {
        compatible = "zmk,keymap";

        #define _
        #define __ 
        #define XXXXXXX   &none
        #define _______   &trans
        #define TO_BS()   &to BASE
        #define CHAR(ch)  &kp ch
        #define SP(layer) &lt layer SPACE
        #define THUMB()   XXXXXXX

        ZMK_LAYER(base_layer,
        #define HR_C(ch) &hm LCTRL ch
        #define HR_A(ch) &hm LALT ch
        #define HR_G(ch) &hm LCMD ch
        #define K_MIN()  AS(MINUS)
        #define K_COM()  &kp COMMA
        #define K_DOT()  &kp DOT
        #define K_SEM()  AS(SEMICOLON)

&kp ESC  CHAR(Q)  CHAR(W)  CHAR(F)  CHAR(P)  CHAR(D) _ CHAR(J)  CHAR(L)  CHAR(U)  CHAR(Y)  K_MIN()  &bspc
&kp TAB  HR_C(A)  HR_A(R)  HR_G(S)  CHAR(T)  CHAR(G) _ CHAR(M)  CHAR(N)  HR_G(E)  HR_A(I)  HR_C(O)  &kp ENTER
&sft_cw  CHAR(Z)  CHAR(X)  CHAR(C)  CHAR(V)  CHAR(B) _ CHAR(K)  CHAR(H)  K_COM()  K_DOT()  K_SEM()  &sft_cw
                     THUMB()  OS(CD1)  SP(SM2) __ SP(SM1) __ SP(SM2)  OS(CD1)  THUMB()
        )

        ZMK_LAYER(sym1_layer,
        #define NUMB(n)  &kp N ## n
        #define NAV_U()  &kp UP
        #define NAV_D()  &kp DOWN
        #define NAV_L()  &nav LA(LEFT) LEFT     // right, right by a word
        #define NAV_R()  &nav LA(RIGHT) RIGHT   // left, left by a word
        #define K_BWD()  &nav LG(LBRC) LG(LBKT) // back, move to tab on left
        #define K_FWD()  &nav LG(RBRC) LG(RBKT) // forwards, move to tab on right
        #define K_EXC()  HR_C(EXCLAMATION)
        #define HN_A(n)  HR_A(N ## n)
        #define HN_G(n)  HR_G(N ## n)
        #define K__AT()  &kp AT
        #define K_CRT()  &kp CARET
        #define K_DLR()  &kp DLLR
        #define K_PCT()  &kp PRCNT
        #define K_AMP()  &kp AMPS
        #define K_HSH()  &kp HASH
        #define K_STR()  &kp STAR
        #define K_SPC()  &kp SPACE
        #define K_SQT()  AS(SINGLE_QUOTE)

_______  NUMB(0)  NUMB(1)  NUMB(2)  NUMB(3)  K_CRT() _ XXXXXXX  XXXXXXX  NAV_U()  XXXXXXX  _______  _______
_______  K_EXC()  HN_A(4)  HN_G(5)  NUMB(6)  K_DLR() _ K_AMP()  NAV_L()  NAV_D()  NAV_R()  K_SQT()  _______
_______  K__AT()  NUMB(7)  NUMB(8)  NUMB(9)  K_PCT() _ K_HSH()  K_STR()  _______  _______  _______  _______
                     THUMB()  OS(CD1)  SP(SM2) __ SP(SM1) __ SP(SM2)  OS(CD1)  THUMB()
        )

        ZMK_LAYER(sym2_layer,
        #define VMUTE()  &kp C_MUTE          // mute
        #define SNCAP()  &kp LSG(N4)         // screen capture
        #define VOL(dir) &kp C_VOL_ ## dir   // volume
        #define BRI(dir) &kp C_BRI_ ## dir   // brightness
        #define BK_R(d)  &kp d ## PAR        // round brackets
        #define BK_C(d)  &kp d ## BRC        // curly braces
        #define BK_S(d)  &kp d ## BKT        // square brackets
        #define BK_A(d)  &kp d ## T          // angle brackets
        #define K_GRV()  &as TILDE GRAVE
        #define K_FSH()  &as QUESTION SLASH
        #define K_BSH()  &as PIPE BACKSLASH

_______  K_GRV()  XXXXXXX  VOL(DN)  VOL(UP)  VMUTE() _ BK_A(G)  BK_A(L)  K_FSH()  K_BSH()  _______  _______
_______  K_EXC()  XXXXXXX  XXXXXXX  BK_S(L)  BK_S(R) _ BK_R(R)  BK_R(L)  K_BWD()  K_FWD()  K_SQT()  _______
_______  K__AT()  XXXXXXX  BRI(DN)  BRI(UP)  SNCAP() _ BK_C(R)  BK_C(L)  XXXXXXX  _______  _______  _______
                     THUMB()  MO(ADM)  XXXXXXX __ SP(SM1) __ XXXXXXX  XXXXXXX  THUMB()
        )

        ZMK_LAYER(code_ref1_layer,
        #define CR_SA() &kp LA(ENTER)      // suggested actions
        #define CR_TC() &kp LG(SLASH)      // toggle comments
        #define CR1_W() &cd LS(F2) F2      // go to next/last error (similar positon to F2)
        #define CR1_A() &kp LSG(A)         // find actions
        #define CR1_R() &kp LS(F6)         // rename
        #define CR1_C() &kp LAG(C)         // extract constant
        #define CR1_F() &kp LAG(F)         // extract field
        #define CR1_P() &kp LAG(P)         // extract parameter
        #define CR1_V() &kp LAG(V)         // extract variable
        #define CR1_M() &kp LAG(M)         // extract method
        #define CR1_N() &kp LAG(N)         // inline
        #define CR1_I() &kp LAG(L)         // format (qwerty position)
        #define CR1_S() &kp LAG(T)         // surround
        #define CR1_B() &cd LG(F9) LSG(F9) // build module, build all
        #define CR1_U() &kp LA(UP)         // extend selection by scope
        #define CR1_E() &kp LA(DOWN)       // decrease selection by scope

TO_BS()  XXXXXXX  CR1_W()  CR1_F()  CR1_P()  XXXXXXX _ XXXXXXX  XXXXXXX  CR1_U()  CR_TC()  XXXXXXX  _______
_______  CR1_A()  CR1_R()  CR1_S()  XXXXXXX  XXXXXXX _ CR1_M()  CR1_N()  CR1_E()  CR1_I()  XXXXXXX  CR_SA()
_______  XXXXXXX  XXXXXXX  CR1_C()  CR1_V()  CR1_B() _ XXXXXXX  XXXXXXX  XXXXXXX  XXXXXXX  XXXXXXX  _______
                     THUMB()  OS(CD2)  MO(ADM) __ XXXXXXX __ XXXXXXX  OS(CD2)  THUMB()
        )

        ZMK_LAYER(code_ref2_layer,
        #define CR2_A() &as F5 F6                // move, copy
        #define CR2_R() &kp LG(F6)               // change signature
        #define CR2_U() &cd LSG(UP) LSA(UP)      // move line up, move block up
        #define CR2_E() &cd LSG(DOWN) LSA(DOWN)  // move line down, move block down

TO_BS()  XXXXXXX  XXXXXXX  XXXXXXX  XXXXXXX  XXXXXXX _ XXXXXXX  XXXXXXX  CR2_U()  XXXXXXX  XXXXXXX  _______
_______  CR2_A()  CR2_R()  XXXXXXX  XXXXXXX  XXXXXXX _ XXXXXXX  XXXXXXX  CR2_E()  CR1_I()  XXXXXXX  CR_SA()
_______  XXXXXXX  XXXXXXX  XXXXXXX  XXXXXXX  XXXXXXX _ XXXXXXX  XXXXXXX  XXXXXXX  XXXXXXX  XXXXXXX  _______
                     THUMB()  OS(CD3)  XXXXXXX __ XXXXXXX __ XXXXXXX  OS(CD3)  THUMB()
        )

        ZMK_LAYER(code_nav_layer,
        #define CN1_F() &cd LSG(R) LSG(F)   // find in project, replace in project
        #define CN1_P() &kp LG(N1)          // project tree tab
        #define CN1_S() &kp LG(F12)         // find symbol in file
        #define CN1_T() &kp LSG(T)          // navigate to/from tests
        #define CN1_R() &kp LSC(R)          // run tests
        #define CN1_D() &kp LSC(D)          // run tests in debug mode
        #define CN1_E() &cd LSG(E) LG(E)    // recent files, recent locations
        #define DBG_I() &cd F7 LS(F7)       // debug: smart step into, step into
        #define DBG_O() &cd LS(F8) F8       // debug: step over, step out
        #define DBG_R() &cd LA(F9) LAG(R)   // debug: run until breakpoint, run until cursor
        #define DBG_B() &cd LG(F8) LA(F8)   // debug: evaluate expression, set breakpoint

TO_BS()  XXXXXXX  XXXXXXX  CN1_F()  CN1_P()  CN1_D() _ XXXXXXX  DBG_I()  DBG_O()  DBG_R()  DBG_B()  _______
_______  XXXXXXX  CN1_R()  CN1_S()  CN1_T()  XXXXXXX _ XXXXXXX  XXXXXXX  CN1_E()  CR1_I()  XXXXXXX  CR_SA()
_______  XXXXXXX  XXXXXXX  &dif_co  XXXXXXX  &dif_br _ XXXXXXX  XXXXXXX  XXXXXXX  XXXXXXX  XXXXXXX  _______
                     THUMB()  OS(CD3)  XXXXXXX __ XXXXXXX __ XXXXXXX  OS(CD3)  THUMB()
        )

        ZMK_LAYER(admin_layer,
        #define FUNC(n)  &kp F ## n
        #define BT_S(n)  &bt BT_SEL n
        #define BT_CL()  &bt BT_CLR
        #define RESET()  &bootloader
        #define CH_KB()  &kp LCA(SPACE)      // change layout
        #define LCK_S()  &kp LCG(Q)          // lock screen

TO_BS()  XXXXXXX  XXXXXXX  XXXXXXX  BT_S(3)  BT_S(0) _ XXXXXXX  FUNC(1)  FUNC(2)  FUNC(3)  XXXXXXX  BT_CL()
XXXXXXX  XXXXXXX  XXXXXXX  XXXXXXX  BT_S(4)  BT_S(1) _ XXXXXXX  FUNC(4)  FUNC(5)  FUNC(6)  XXXXXXX  XXXXXXX
XXXXXXX  XXXXXXX  XXXXXXX  XXXXXXX  BT_S(5)  BT_S(2) _ XXXXXXX  FUNC(7)  FUNC(8)  FUNC(9)  XXXXXXX  RESET()
                     THUMB()  XXXXXXX  XXXXXXX __ XXXXXXX __ CH_KB()  LCK_S()  THUMB()
        )
    };
};